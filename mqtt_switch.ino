#include <SPI.h>
#include <URTouch.h>
#include <Adafruit_GFX.h>
#include <Adafruit_ILI9341.h>
#include <SoftwareSerial.h>


SoftwareSerial wifi(8,2); 

//Pines TFT
#define TFT_DC 9
#define TFT_CS 10

//Pines Touch
#define t_SCK  3
#define t_CS   4
#define t_MOSI 5
#define t_MISO 6
#define t_IRQ  7


static const uint8_t  PROGMEM ceiling_light[] ={0x00, 0x00, 0x00, 0x00, 0x00, 0x00, 0x00, 0x00, 0x00, 0x00, 0x00, 0x00, 0x00, 0x00, 0x00, 0x00, 
0x00, 0x00, 0x00, 0x00, 0x00, 0x00, 0x00, 0x00, 0x00, 0x00, 0x00, 0x00, 0x00, 0x00, 0x00, 0x00, 
0x00, 0x00, 0x00, 0x00, 0x00, 0x00, 0x00, 0x00, 0x00, 0x00, 0x00, 0x00, 0x00, 0x00, 0x00, 0x00, 
0x00, 0x00, 0x03, 0xc0, 0x00, 0x00, 0x00, 0x00, 0x03, 0xc0, 0x00, 0x00, 0x00, 0x00, 0x03, 0xc0, 
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0x00, 0x00, 0x00, 0x00, 0x00, 0x00, 0x00, 0x00, 0x00, 0x00, 0x00, 0x00, 0x00, 0x00, 0x00, 0x00};

static const uint8_t  PROGMEM spotlight_beam[] ={0x00, 0x00, 0x00, 0x00, 0x00, 0x00, 0x00, 0x00, 0x00, 0x00, 0x00, 0x00, 0x00, 0x00, 0x00, 0x00, 
0x00, 0x00, 0x00, 0x00, 0x00, 0x00, 0x00, 0x00, 0x00, 0x70, 0x00, 0x00, 0x00, 0x00, 0x00, 0xf8, 
0x00, 0x00, 0x00, 0x00, 0x01, 0xfe, 0x00, 0x00, 0x00, 0x00, 0x03, 0xfe, 0x00, 0x00, 0x00, 0x00, 
0x07, 0xff, 0x00, 0x00, 0x00, 0x00, 0x0f, 0xff, 0x80, 0x00, 0x00, 0x00, 0x0f, 0xff, 0xc0, 0x00, 
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0x00, 0x00, 0x00, 0x00, 0x00, 0x00, 0x00, 0x00, 0x00, 0x00, 0x00, 0x00, 0x00, 0x00, 0x00, 0x00};

static const uint8_t  PROGMEM lamp[] ={0x00, 0x00, 0x00, 0x00, 0x00, 0x00, 0x00, 0x00, 0x00, 0x00, 0x00, 0x00, 0x00, 0x00, 0x00, 0x00, 
0x00, 0x00, 0x00, 0x00, 0x00, 0x00, 0x00, 0x00, 0x00, 0x00, 0xff, 0xff, 0x00, 0x00, 0x00, 0x00, 
0xff, 0xff, 0x00, 0x00, 0x00, 0x01, 0xff, 0xff, 0x80, 0x00, 0x00, 0x01, 0xff, 0xff, 0x80, 0x00, 
0x00, 0x01, 0xff, 0xff, 0x80, 0x00, 0x00, 0x03, 0xff, 0xff, 0xc0, 0x00, 0x00, 0x03, 0xff, 0xff, 
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0x00, 0x00, 0x00, 0x00, 0x00, 0x00, 0x00, 0x00, 0x00, 0x00, 0x00, 0x00, 0x00, 0x00, 0x00, 0x00};
long x, y;

int switch_1_status = 0;
int switch_2_status = 0;
int switch_3_status = 0;
int switch_4_status = 0;

  int button_margin = 2;
  int button_w = 238;
  int button_h=70;
  
  int button_start_1 = 10;
  int button_start_2 = 90;
  int button_start_3 = 170;
  int button_start_4 = 250;
  
  int button_color_fill_off =  0x39E7;
  int button_color_fill_on = 0x7BCF;
  
  int button_color_icon_off = 0x738E;
  int button_color_icon_on = 0xFFFF;
  
  int button_color_text_off = 0x738E;
  int button_color_text_on = 0xFFFF;

int button[4][6] = 

{
  {ceiling_light, button_margin, button_start_1,button_w, button_h,0},
  {spotlight_beam, button_margin, button_start_2,button_w, button_h,0},
  {lamp, button_margin, button_start_3,button_w, button_h, 0},
  {lamp, button_margin, button_start_4,button_w, button_h, 0}
};

String button_name[4] =
{
  "ceiling",
  "Desk",
  "TV",
  "Sofa"
};

String new_message;
String message;

Adafruit_ILI9341 tft = Adafruit_ILI9341(TFT_CS, TFT_DC);
URTouch ts(t_SCK, t_CS, t_MOSI, t_MISO, t_IRQ);
 
void setup(){

  
  
  tft.begin();
  tft.setRotation(0);  
  tft.fillScreen(ILI9341_BLACK); 


  for (int i=0; i<4; i++) {
  button_status(button[i][0],button_name[i],button[i][1],button[i][2],button[i][3],button[i][4],button_color_fill_off, button_color_icon_off, button_color_text_off);
  }
  
  ts.InitTouch();
  ts.setPrecision(PREC_MEDIUM);
  tft.setTextColor(ILI9341_WHITE);

  Serial.begin(9600); 
  wifi.begin(9600);


}
 
void loop()
{


 if (wifi.available()){
        message = wifi.readString();
        message.trim();

if (message == "cmnd/MT_1/POWER/ON") {button[0][5] = 0;button_change(0,40);}
if (message == "cmnd/MT_1/POWER/OFF") {button[0][5] = 1;button_change(0,40);}      

  if (message == "cmnd/MT_2/POWER/ON") {button[1][5] = 0;button_change(1,120);}
if (message == "cmnd/MT_2/POWER/OFF") {button[1][5] = 1;button_change(1,120);}  

if (message == "cmnd/MT_3/POWER/ON") {button[2][5] = 0;button_change(2,200);}
if (message == "cmnd/MT_3/POWER/OFF") {button[2][5] = 1;button_change(2,200);}  

if (message == "cmnd/MT_4/POWER/ON") {button[3][5] = 0;button_change(3,270);}
if (message == "cmnd/MT_4/POWER/OFF") {button[3][5] = 1;button_change(3,270);}  
       
      } 

     


      
while(ts.dataAvailable())
  {
    ts.read();
    x = (ts.getX()-320)*-1;
    y = ts.getY();

    button_change_send(0,x);
    button_change_send(1,x);
    button_change_send(2,x);
    button_change_send(3,x);

  }

}
 
void button_status(const uint8_t *icon_name, String text_name,int s_x, int s_y, int w,int h,int color_fill,int color_icon, int color_text) {

        tft.fillRoundRect(s_x, s_y, w, h, 3,color_fill);
        tft.drawBitmap(s_x+10, s_y+10, icon_name, 48, 48, color_icon);
        tft.setTextColor(color_text);
        tft.setTextSize(3);
        tft.setCursor(s_x+10+58,s_y+20);
        tft.print(text_name);
  
}

void button_change_send (int Num_Button, int x) {
    
    if (x > button[Num_Button][2]  and x < button[Num_Button][2]+button[Num_Button][4]) 
      {
        if (button[Num_Button][5] == 0) {
          button_status(button[Num_Button][0],button_name[Num_Button],button[Num_Button][1],button[Num_Button][2],button[Num_Button][3],button[Num_Button][4],button_color_fill_on, button_color_icon_on, button_color_text_on);
        button[Num_Button][5] = 1;
       if (Num_Button == 0) {wifi.write("1");}
         if (Num_Button == 1) {wifi.write("2");}
          if (Num_Button == 2) {wifi.write("3");}
           if (Num_Button == 3) {wifi.write("4");}
        wifi.write("ON");
        delay(20);
        }else{
          button_status(button[Num_Button][0],button_name[Num_Button],button[Num_Button][1],button[Num_Button][2],button[Num_Button][3],button[Num_Button][4],button_color_fill_off, button_color_icon_off, button_color_text_off);
        button[Num_Button][5] = 0;
              if (Num_Button == 0) {wifi.write("1");}
         if (Num_Button == 1) {wifi.write("2");}
          if (Num_Button == 2) {wifi.write("3");}
           if (Num_Button == 3) {wifi.write("4");}
        wifi.write("OFF");
        delay(20);   
        }
      }

}

void button_change (int Num_Button, int x) {
    
    if (x > button[Num_Button][2]  and x < button[Num_Button][2]+button[Num_Button][4]) 
      {
        if (button[Num_Button][5] == 0) {
          button_status(button[Num_Button][0],button_name[Num_Button],button[Num_Button][1],button[Num_Button][2],button[Num_Button][3],button[Num_Button][4],button_color_fill_on, button_color_icon_on, button_color_text_on);
        button[Num_Button][5] = 1;
        delay(20);
        }else{
          button_status(button[Num_Button][0],button_name[Num_Button],button[Num_Button][1],button[Num_Button][2],button[Num_Button][3],button[Num_Button][4],button_color_fill_off, button_color_icon_off, button_color_text_off);
        button[Num_Button][5] = 0;
        delay(20);   
        }
      }

}
